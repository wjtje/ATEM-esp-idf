## Kconfig
```kconfig
menu "ATEM Communication"

  config PACKET_BUFFER_SIZE
    int "Size of the internal buffer to store a packet"
    default 1600

  config ATEM_DEBUG_MUTEX_CHECK
    bool "Check the atem mutex is locked before running function that requires it"
    default 0

  config ATEM_STORE_SEND
    bool "Store send packages, this increases memory usage but improves stability on buggy networks"
    default 1

endmenu
```

## example/basic-preview-switcher/main/Kconfig.projbuild
```kconfig
menu "ATEM-esp-idf example"

  config WIFI_SSID
    string "The ssid of the AP to connect to"
  
  config WIFI_PSK
    string "The PSK of the AP to connect to"
  
  config ATEM_IP
    string "The IP address of the ATEM to connect to"

endmenu
```
